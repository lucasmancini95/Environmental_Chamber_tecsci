
//Standard libraries
#include <stdio.h>
//ESP libraries
#include "driver/gpio.h"
#include "driver/i2c.h"
#include "esp_err.h"
#include "esp_log.h"
#include "freertos/task.h"
#include "sdkconfig.h" // generated by "make menuconfig"

//Bosch Sensor BME280 librarie
#include "bme280.h"
//Environmetal Chamber libraries
#include "sensor.h"

//Global:

sensor_t sensor_1; //adress --> with the pin SDO at VCC --> address==BME280_I2C_ADDRESS1==0x76
sensor_t sensor_2; //adress --> with the pin SDO at GND --> address==BME280_I2C_ADDRESS2==0x77



double get_actual_average_RH(){

return (get_sensor_RH(&sensor_2));  //    +get_sensor_RH(&sensor_1))/2;

}

double get_actual_average_TEMP(){

return (get_sensor_TEMP(&sensor_2));  //    +get_sensor_RH(&sensor_1))/2;

}

double get_actual_average_PSS(){

return (get_sensor_PSS(&sensor_2));  //    +get_sensor_RH(&sensor_1))/2;

}

double get_sensor_RH(sensor_t* p_sensor_x){

	double readed_compensate_humidity;

			p_sensor_x->com_rslt = bme280_read_uncomp_humidity(&(p_sensor_x->v_uncomp_humidity_s32));

			if (p_sensor_x->com_rslt == SUCCESS) {
				readed_compensate_humidity=bme280_compensate_humidity_double(p_sensor_x->v_uncomp_humidity_s32);

				//ESP_LOGI(TAG_BME280, "%.3f %%",readed_compensate_humidity);
				return readed_compensate_humidity;
			}

	ESP_LOGE(TAG_BME280, "measure error. code: %d", p_sensor_x->com_rslt);
	return -1;

}

double get_sensor_TEMP(sensor_t* p_sensor_x){

	double readed_compensate_temperature;

			p_sensor_x->com_rslt = bme280_read_uncomp_temperature(&(p_sensor_x->v_uncomp_temperature_s32));

			if (p_sensor_x->com_rslt == SUCCESS) {
				readed_compensate_temperature=bme280_compensate_temperature_double(p_sensor_x->v_uncomp_temperature_s32);

				//ESP_LOGI(TAG_BME280, "%.3f %%",readed_compensate_humidity);
				return readed_compensate_temperature;
			}

	ESP_LOGE(TAG_BME280, "measure error. code: %d", p_sensor_x->com_rslt);
	return -1;

}

double get_sensor_PSS(sensor_t* p_sensor_x){

	double readed_compensate_pressure;

			p_sensor_x->com_rslt = bme280_read_uncomp_pressure(&(p_sensor_x->v_uncomp_pressure_s32));

			if (p_sensor_x->com_rslt == SUCCESS) {
				readed_compensate_pressure=bme280_compensate_pressure_double(p_sensor_x->v_uncomp_pressure_s32);

				//ESP_LOGI(TAG_BME280, "%.3f %%",readed_compensate_humidity);
				return readed_compensate_pressure;
			}

	ESP_LOGE(TAG_BME280, "measure error. code: %d", p_sensor_x->com_rslt);
	return -1;

}

void sensor_RH_init(){

	i2c_master_init();

	sensor_bme280_init(&sensor_1,BME280_I2C_ADDRESS1);
	sensor_bme280_init(&sensor_2,BME280_I2C_ADDRESS2);

}

void sensor_bme280_init(sensor_t* p_sensor_x, unsigned int address){
	double readed_compensate_humidity;
	double readed_compensate_temperature;
	double readed_compensate_pressure;


	(p_sensor_x->bme280).bus_write = BME280_I2C_bus_write;
	(p_sensor_x->bme280).bus_read = BME280_I2C_bus_read;
	(p_sensor_x->bme280).dev_addr = address;
	(p_sensor_x->bme280).delay_msec = BME280_delay_msek;


	(p_sensor_x->com_rslt) = bme280_init(&(p_sensor_x->bme280));

	(p_sensor_x->com_rslt)  += bme280_set_oversamp_pressure(BME280_OVERSAMP_16X);
 	(p_sensor_x->com_rslt) += bme280_set_oversamp_temperature(BME280_OVERSAMP_2X);
	(p_sensor_x->com_rslt) += bme280_set_oversamp_humidity(BME280_OVERSAMP_1X);

(p_sensor_x->com_rslt) += bme280_set_standby_durn(BME280_STANDBY_TIME_1_MS);
(p_sensor_x->com_rslt) += bme280_set_filter(BME280_FILTER_COEFF_16);

(p_sensor_x->com_rslt) += bme280_set_power_mode(BME280_NORMAL_MODE);

	if ((p_sensor_x->com_rslt) == SUCCESS) {

			vTaskDelay(40/portTICK_PERIOD_MS);
			(p_sensor_x->com_rslt)= bme280_read_uncomp_humidity(&(p_sensor_x->v_uncomp_humidity_s32));
			(p_sensor_x->com_rslt)= bme280_read_uncomp_temperature(&(p_sensor_x->v_uncomp_temperature_s32));
			(p_sensor_x->com_rslt)= bme280_read_uncomp_pressure(&(p_sensor_x->v_uncomp_pressure_s32));


			if ((p_sensor_x->com_rslt) == SUCCESS) {

				readed_compensate_humidity=bme280_compensate_humidity_double((p_sensor_x->v_uncomp_humidity_s32));
				readed_compensate_temperature=bme280_compensate_humidity_double((p_sensor_x->v_uncomp_temperature_s32));
				readed_compensate_pressure=bme280_compensate_humidity_double((p_sensor_x->v_uncomp_pressure_s32));

				printf("Init Reading\n");
				ESP_LOGI(TAG_BME280, "%.3f %%",readed_compensate_humidity);
				ESP_LOGI(TAG_BME280, "%.2f degC",readed_compensate_temperature);
				ESP_LOGI(TAG_BME280, "%.3f hPa",readed_compensate_pressure);

			} else {

				ESP_LOGE(TAG_BME280, "measure error. code: %d", (p_sensor_x->com_rslt));
			}

	} else {
		ESP_LOGE(TAG_BME280, "init or setting error. code: %d", (p_sensor_x->com_rslt));
	}
}

void i2c_master_init()
{
	i2c_config_t i2c_config = {
		.mode = I2C_MODE_MASTER,
		.sda_io_num = SDA_PIN,
		.scl_io_num = SCL_PIN,
		.sda_pullup_en = GPIO_PULLUP_ENABLE,
		.scl_pullup_en = GPIO_PULLUP_ENABLE,
		.master.clk_speed = 1000000
	};
	i2c_param_config(I2C_NUM_0, &i2c_config);
	i2c_driver_install(I2C_NUM_0, I2C_MODE_MASTER, 0, 0, 0);
}


s8 BME280_I2C_bus_write(u8 dev_addr, u8 reg_addr, u8 *reg_data, u8 cnt)
{
	s32 iError = BME280_INIT_VALUE;

	esp_err_t espRc;
	i2c_cmd_handle_t cmd = i2c_cmd_link_create();

	i2c_master_start(cmd);
	i2c_master_write_byte(cmd, (dev_addr << 1) | I2C_MASTER_WRITE, true);

	i2c_master_write_byte(cmd, reg_addr, true);
	i2c_master_write(cmd, reg_data, cnt, true);
	i2c_master_stop(cmd);

	espRc = i2c_master_cmd_begin(I2C_NUM_0, cmd, 10/portTICK_PERIOD_MS);
	if (espRc == ESP_OK) {
		iError = SUCCESS;
	} else {
		iError = FAIL;
	}
	i2c_cmd_link_delete(cmd);

	return (s8)iError;
}


s8 BME280_I2C_bus_read(u8 dev_addr, u8 reg_addr, u8 *reg_data, u8 cnt)
{
	s32 iError = BME280_INIT_VALUE;
	esp_err_t espRc;

	i2c_cmd_handle_t cmd = i2c_cmd_link_create();

	i2c_master_start(cmd);
	i2c_master_write_byte(cmd, (dev_addr << 1) | I2C_MASTER_WRITE, true);
	i2c_master_write_byte(cmd, reg_addr, true);

	i2c_master_start(cmd);
	i2c_master_write_byte(cmd, (dev_addr << 1) | I2C_MASTER_READ, true);

	if (cnt > 1) {
		i2c_master_read(cmd, reg_data, cnt-1, I2C_MASTER_ACK);
	}
	i2c_master_read_byte(cmd, reg_data+cnt-1, I2C_MASTER_NACK);
	i2c_master_stop(cmd);

	espRc = i2c_master_cmd_begin(I2C_NUM_0, cmd, 10/portTICK_PERIOD_MS);
	if (espRc == ESP_OK) {
		iError = SUCCESS;
	} else {
		iError = FAIL;
	}

	i2c_cmd_link_delete(cmd);

	return (s8)iError;
}

void BME280_delay_msek(u32 msek)
{
	vTaskDelay(msek/portTICK_PERIOD_MS);
}



//Testing tasks: there are two modes normal and forced

//xTaskCreate(&task_environmental_chamber_control, "task_environmental_chamber_control",  2048, NULL, 6, NULL);
//xTaskCreate(&task_bme280_RH_set_point_test, "bme280_RH_set_point_test",  2048, NULL, 6, NULL);
//xTaskCreate(&task_bme280_normal_mode, "bme280_normal_mode",  2048, NULL, 6, NULL);
// xTaskCreate(&task_bme280_forced_mode, "bme280_forced_mode",  2048, NULL, 6, NULL);


// void task_environmental_chamber_control(){
//
// 	double actual_average_RH;
//
// 	while(1){
// 		vTaskDelay(40/portTICK_PERIOD_MS);
//
// 		actual_average_RH=get_actual_average_RH(bme280_1,com_rslt_1,v_uncomp_humidity_s32_1); //en realidad deberia ser sensor_t
//
// 	if(actual_average_RH<=(RH_SETPOINT+UPPER_LIM)&& actual_average_RH>=(RH_SETPOINT-LOWER_LIM)){  //keep humidity
// 		printf("State: keep Humidity\n");
// 		humidifier_low();
// 		dryer_low();
//
// 	}
//
// 	else if(actual_average_RH>(RH_SETPOINT+UPPER_LIM)){  //dehumidify
// 		printf("State: dehumidify\n");
//
// 		humidifier_low();
// 		dryer_high();
//
// 	}
// 	else if(actual_average_RH<(RH_SETPOINT-LOWER_LIM)){  //humidify
//
// 		printf("State: humidify\n");
//
// 		humidifier_high();
// 		dryer_low();
// 	}
//
// 	}
//
// }

void task_bme280_RH_set_point_test(void *ignore){

	struct bme280_t bme280 = {
		.bus_write = BME280_I2C_bus_write,
		.bus_read = BME280_I2C_bus_read,
		.dev_addr = BME280_I2C_ADDRESS1,
		.delay_msec = BME280_delay_msek
	};

	double readed_compensate_humidity;
	s32 com_rslt;
	s32 v_uncomp_humidity_s32;

	com_rslt = bme280_init(&bme280);
	com_rslt += bme280_set_oversamp_humidity(BME280_OVERSAMP_1X);

	com_rslt += bme280_set_standby_durn(BME280_STANDBY_TIME_1_MS);
	com_rslt += bme280_set_filter(BME280_FILTER_COEFF_16);

	com_rslt += bme280_set_power_mode(BME280_NORMAL_MODE);

	if (com_rslt == SUCCESS) {
		while(true) {

			vTaskDelay(40/portTICK_PERIOD_MS);
			com_rslt = bme280_read_uncomp_humidity(&v_uncomp_humidity_s32);

			if (com_rslt == SUCCESS) {

				readed_compensate_humidity=bme280_compensate_humidity_double(v_uncomp_humidity_s32);

				if( (RH_SETPOINT-LOWER_LIM<readed_compensate_humidity)  && (readed_compensate_humidity<RH_SETPOINT+UPPER_LIM)){
					printf("SET POINT REACHED\n");
				}
				else{
					ESP_LOGI(TAG_BME280, "%.3f %%",readed_compensate_humidity);
				}

			} else {
				ESP_LOGE(TAG_BME280, "measure error. code: %d", com_rslt);
			}
		}

	} else {
		ESP_LOGE(TAG_BME280, "init or setting error. code: %d", com_rslt);
	}

	vTaskDelete(NULL);

}


void task_bme280_normal_mode(void *ignore)
{
	struct bme280_t bme280 = {
		.bus_write = BME280_I2C_bus_write,
		.bus_read = BME280_I2C_bus_read,
		.dev_addr = BME280_I2C_ADDRESS2,
		.delay_msec = BME280_delay_msek
	};

	s32 com_rslt;
	s32 v_uncomp_pressure_s32;
	s32 v_uncomp_temperature_s32;
	s32 v_uncomp_humidity_s32;

	com_rslt = bme280_init(&bme280);

	com_rslt += bme280_set_oversamp_pressure(BME280_OVERSAMP_16X);
	com_rslt += bme280_set_oversamp_temperature(BME280_OVERSAMP_2X);
	com_rslt += bme280_set_oversamp_humidity(BME280_OVERSAMP_1X);

	com_rslt += bme280_set_standby_durn(BME280_STANDBY_TIME_1_MS);
	com_rslt += bme280_set_filter(BME280_FILTER_COEFF_16);

	com_rslt += bme280_set_power_mode(BME280_NORMAL_MODE);
	if (com_rslt == SUCCESS) {
		while(true) {
			vTaskDelay(40/portTICK_PERIOD_MS);

			com_rslt = bme280_read_uncomp_pressure_temperature_humidity(
				&v_uncomp_pressure_s32, &v_uncomp_temperature_s32, &v_uncomp_humidity_s32);

			if (com_rslt == SUCCESS) {
				ESP_LOGI(TAG_BME280, "%.2f degC / %.3f hPa / %.3f %%",
					bme280_compensate_temperature_double(v_uncomp_temperature_s32),
					bme280_compensate_pressure_double(v_uncomp_pressure_s32)/100, // Pa -> hPa
					bme280_compensate_humidity_double(v_uncomp_humidity_s32));
			} else {
				ESP_LOGE(TAG_BME280, "measure error. code: %d", com_rslt);
			}
		}
	} else {
		ESP_LOGE(TAG_BME280, "init or setting error. code: %d", com_rslt);
	}

	vTaskDelete(NULL);
}

void task_bme280_forced_mode(void *ignore) {
	struct bme280_t bme280 = {
		.bus_write = BME280_I2C_bus_write,
		.bus_read = BME280_I2C_bus_read,
		.dev_addr = BME280_I2C_ADDRESS2,
		.delay_msec = BME280_delay_msek
	};

	s32 com_rslt;
	s32 v_uncomp_pressure_s32;
	s32 v_uncomp_temperature_s32;
	s32 v_uncomp_humidity_s32;

	com_rslt = bme280_init(&bme280);

	com_rslt += bme280_set_oversamp_pressure(BME280_OVERSAMP_1X);
	com_rslt += bme280_set_oversamp_temperature(BME280_OVERSAMP_1X);
	com_rslt += bme280_set_oversamp_humidity(BME280_OVERSAMP_1X);

	com_rslt += bme280_set_filter(BME280_FILTER_COEFF_OFF);
	if (com_rslt == SUCCESS) {
		while(true) {
			com_rslt = bme280_get_forced_uncomp_pressure_temperature_humidity(
				&v_uncomp_pressure_s32, &v_uncomp_temperature_s32, &v_uncomp_humidity_s32);

			if (com_rslt == SUCCESS) {
				ESP_LOGI(TAG_BME280, "%.2f degC / %.3f hPa / %.3f %%",
					bme280_compensate_temperature_double(v_uncomp_temperature_s32),
					bme280_compensate_pressure_double(v_uncomp_pressure_s32)/100, // Pa -> hPa
					bme280_compensate_humidity_double(v_uncomp_humidity_s32));
			} else {
				ESP_LOGE(TAG_BME280, "measure error. code: %d", com_rslt);
			}
		}
	} else {
		ESP_LOGE(TAG_BME280, "init or setting error. code: %d", com_rslt);
	}

	vTaskDelete(NULL);
}
