#include "environmental_chamber_handlers.h"

//Standard libraries
#include <stdio.h>
#include <stdbool.h>
//ESP libraries
#include "driver/gpio.h"
#include "driver/i2c.h"
#include "esp_err.h"
#include "esp_log.h"
#include "freertos/task.h"
#include "sdkconfig.h" // generated by "make menuconfig"

#include "custom_bool.h"
#include "environmental_chamber_Control.h"
#include "environmental_chamber_monitor.h"
#include "sensor.h"

void Handler_EnvironmentalChamberRunProcess(cbool_t rh_activate,cbool_t temp_activate, double targetRH, double targetTemp){


  if(rh_activate == cTRUE && temp_activate==cTRUE){
    printf("se correra el control de RH y TEMP\n");
    enable_RH_Task(targetRH);
    enable_TEMP_Task(targetTemp);
  }
  else if(rh_activate == cTRUE && temp_activate==cFALSE){
        printf("se correra el control de RH\n");
        enable_RH_Task(targetRH);
  }

  else if(rh_activate == cFALSE && temp_activate==cTRUE){
        printf("se correra el control de TEMP\n");
        enable_TEMP_Task(targetTemp);
  }
 return;

}

void Handler_EnvironmentalChamberStopProcess(){
    printf("se parara cualquier proceso de control\n");
    stop_RH_Task();
 return;
}


void Handler_EnvironmentalChamberMonitor(double* p_actual_RH,double* p_actual_TEMP,chamberRunState_t* p_RH_state, chamberRunState_t* p_TEMP_state){

  (*p_actual_RH)=get_actual_average_RH();
  (*p_actual_TEMP)=get_actual_average_TEMP();
  //(*p_actual_PSS)=get_actual_average_PSS();

  (*p_RH_state)= get_process_RH_state();
  (*p_TEMP_state)= get_process_TEMP_state();


}
